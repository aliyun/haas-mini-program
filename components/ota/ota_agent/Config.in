## components/ota/ota_agent/Config.in
```kconfig
if CONFIG_AOS_OTA_AGENT

config OTA_CONFIG_DOWNLOAD
    bool "Download Config"
    default n
    help
    select Y to config OTA download.

if OTA_CONFIG_DOWNLOAD
config OTA_CONFIG_SECURE_DL_MODE
    bool "Secure Download Mode"
    select CONFIG_HTTP_SECURE
    default n
    help
    select Y to enter into OTA secure download mode, only run download task in this mode.

config OTA_DOWNLOAD_RETRY_CNT
    int "Download Retry Count"
    default 5
    help
    setup ota download retry count when fail to download.

config OTA_DOWNLOAD_TIMEOUT
    int "Download Timeout(ms)"
    default 20000
    help
    setup ota download timeout, default:20000.

config OTA_DOWNLOAD_BLOCK_SIZE
    int "Download Block Size(bytes)"
    default 512
    help
    setup ota download block size.
endif

if OTA_CONFIG_MCU_OTA
config OTA_CONFIG_MCU_YMODEM
    bool "Ymodem upgrade Support"
    default n
    help
    select Y to support ymodem upgrade for MCU OTA.

config OTA_CONFIG_MCU_CAN
    bool "CAN Master upgrade Support"
    default n
    help
    select Y to support CAN master upgrade for MCU OTA.

config OTA_CONFIG_MCU_UBUS
    bool "UBUS Master upgrade Support"
    default n
    help
    select Y to support UBUS master upgrade for MCU OTA.

config OTA_CONFIG_LOCAL_UART_DOWNLOAD
    bool "UART Master local upgrade Support"
    default n
    help
    select Y to support local upgrade by UART for master.
endif

config OTA_CONFIG_BLE
    bool "BLE upgrade Support"
    default y if AOS_COMP_BREEZE
    default n
    help
    select Y to support BLE upgrade.

config OTA_CONFIG_UAGENT
    bool "OTA via uAgent"
    select AOS_COMP_UAGENT
    default n
    help
    mount ota function to uAgent

config OTA_CONFIG_SLAVE
    bool "slave dev upgrade support"
    default n
    help
    select Y to support slave device upgrade

endif
```
